## configs/recore_defconfig
```kconfig
CONFIG_ARM=y
CONFIG_ARCH_SUNXI=y
CONFIG_SPL=y
CONFIG_MACH_SUN50I=y
CONFIG_MMC_SUNXI_SLOT_EXTRA=2
CONFIG_RESERVE_ALLWINNER_BOOT0_HEADER=y
CONFIG_DEFAULT_DEVICE_TREE="sun50i-a64-recore-a4"
CONFIG_OF_LIST="sun50i-a64-recore-a3 sun50i-a64-recore-a4"
CONFIG_PREBOOT="gpio set PH0; gpio set PH1; gpio set PH2; gpio set PH3; gpio set PG9"
CONFIG_BOOTDELAY=1
CONFIG_PHY_REALTEK=y
CONFIG_SUN8I_EMAC=y
CONFIG_USB_EHCI_HCD=y
CONFIG_USB_OHCI_HCD=y
# CONFIG_ENV_IS_IN_FAT is not set
```
